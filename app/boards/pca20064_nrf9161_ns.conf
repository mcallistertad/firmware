## app/src/modules/device_info/Kconfig.device_info
```kconfig
# Copyright (c) 2026 Nordic Semiconductor
#
# SPDX-License-Identifier: LicenseRef-Nordic-5-Clause
#

menu "Device information"
	depends on MODEM_INFO

config APP_DEVICE_INFO_BATTERY_MODEL
	string "Battery model reported to hello.nrfcloud.com"
	default "LP803448"
	help
	  Battery model published in resource 5 of Device Information object 14204.

module = APP_DEVICE_INFO
module-str = Device information
source "subsys/logging/Kconfig.template.log_config"

endmenu # Device information
```

## boards/nordic/pca20064/Kconfig
```kconfig
# Copyright (c) 2026
# SPDX-License-Identifier: LicenseRef-Nordic-5-Clause

if BOARD_PCA20064_NRF9161 || BOARD_PCA20064_NRF9161_NS

module = BOARD
module-str = PCA20064 board
source "subsys/logging/Kconfig.template.log_config"

endif
```

## boards/nordic/pca20064/Kconfig.pca20064
```kconfig
# Copyright (c) 2026
# SPDX-License-Identifier: LicenseRef-Nordic-5-Clause

config BOARD_PCA20064
	select SOC_NRF9161_LACA
```

## boards/nordic/pca20064/board.yml
```yaml
board:
  name: pca20064
  full_name: Thingy:91 X PCA20064 (nRF9161 prototype)
  vendor: nordic
  socs:
    - name: nrf9161
      variants:
        - name: ns
```

## boards/nordic/pca20064/pca20064_nrf9161_defconfig
```kconfig
# Copyright (c) 2026
# SPDX-License-Identifier: LicenseRef-Nordic-5-Clause

CONFIG_ARM_MPU=y
CONFIG_HW_STACK_PROTECTION=y
CONFIG_ARM_TRUSTZONE_M=y
CONFIG_PINCTRL=y
CONFIG_GPIO=y
CONFIG_SERIAL=y
CONFIG_CONSOLE=y
CONFIG_UART_CONSOLE=y
CONFIG_CLOCK_CONTROL_NRF_K32SRC_RC=y
CONFIG_CLOCK_CONTROL_NRF_K32SRC_500PPM=y
```

## boards/nordic/pca20064/pca20064_nrf9161_ns_defconfig
```kconfig
# Copyright (c) 2026
# SPDX-License-Identifier: LicenseRef-Nordic-5-Clause

CONFIG_ARM_MPU=y
CONFIG_HW_STACK_PROTECTION=y
CONFIG_ARM_TRUSTZONE_M=y
CONFIG_TRUSTED_EXECUTION_NONSECURE=y
CONFIG_PINCTRL=y
CONFIG_GPIO=y
CONFIG_SERIAL=y
CONFIG_CONSOLE=y
CONFIG_UART_CONSOLE=y
CONFIG_I2C=y
CONFIG_SPI=y
CONFIG_FLASH=y
CONFIG_SPI_NOR=y
CONFIG_SPI_NOR_SFDP_RUNTIME=y
CONFIG_SPI_NOR_FLASH_LAYOUT_PAGE_SIZE=4096
CONFIG_CLOCK_CONTROL_NRF_K32SRC_RC=y
CONFIG_CLOCK_CONTROL_NRF_K32SRC_500PPM=y
```

## dts/bindings/misc/nordic,pca20064-raw-spi.yaml
```yaml
description: Raw SPI device used only by the guarded PCA20064 hardware probe
compatible: "nordic,pca20064-raw-spi"
include: spi-device.yaml
```

## tests/module/cloud_send/testcase.yaml
```yaml
tests:
  hello_nrfcloud.fw.cloud_send:
    platform_allow:
      - native_sim
      - native_sim/native/64
      - qemu_cortex_m3
    integration_platforms:
      - native_sim
      - qemu_cortex_m3
```

## tests/module/location/testcase.yaml
```yaml
tests:
  hello_nrfcloud.fw.location_payload:
    platform_allow:
      - native_sim
      - native_sim/native/64
      - qemu_cortex_m3
    integration_platforms:
      - native_sim
      - qemu_cortex_m3
```
